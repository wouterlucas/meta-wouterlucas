## conf/layer.conf
```bitbake
BBPATH .= ":${LAYERDIR}"

BBFILES += "\
            ${LAYERDIR}/recipes-*/*/*.bb \
            ${LAYERDIR}/recipes-*/*/*.bbappend \
           "

BBFILE_COLLECTIONS += "wouterlucas-layer"
BBFILE_PATTERN_wouterlucas-layer := "^${LAYERDIR}/"
BBFILE_PRIORITY_wouterlucas-layer = "10"

LAYERSERIES_COMPAT_wouterlucas-layer = "sumo"

LAYERDEPENDS_wpe-restricted-layer = "core \
                          openembedded-layer \
                         "

LICENSE_PATH += "${LAYERDIR}/licenses"

CONNECTIVITY_CHECK_URIS ?= "https://www.example.com/"
```
